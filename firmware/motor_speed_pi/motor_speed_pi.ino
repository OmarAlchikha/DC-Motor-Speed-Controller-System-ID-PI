/*
 * motor_speed_pi.ino -- PI speed control of a brushed DC motor, 100 Hz.
 *
 * Board:  Arduino Mega 2560
 * Power:  motor runs from Project 1's buck output (5.0 V, 2 A budget;
 *         motor chosen so stall current 5.0/2.7 = 1.85 A < 2 A).
 *         The Mega is powered from USB; grounds MUST be common.
 *
 * Drive:  single-quadrant low-side switch.
 *         Pin 11 (Timer1, ~31.4 kHz PWM) -> 150R -> gate of logic-level
 *         N-FET (IRLB8721 / IRLZ44N), source to GND, drain to motor-.
 *         Motor+ to buck 5 V. Schottky freewheel diode (SB540, same part
 *         as Project 1) across the motor, cathode to 5 V.
 *         31.4 kHz is far above the motor's electrical pole (~1 ms), so
 *         the winding sees the duty-average voltage: v = duty * VBUS.
 *
 * Feedback: quadrature encoder on the motor shaft.
 *         Channel A -> pin 2 (INT4), channel B -> pin 3 (INT5).
 *         CPR below = counts per rev *after* x4 decoding (both edges of
 *         both channels). Speed = count difference per 10 ms window.
 *         Resolution: 2*pi/CPR/TS = 13.1 rad/s per count at CPR=48 --
 *         hence the 15 Hz measurement LPF, whose phase lag is part of
 *         the loop design (control-design/design_report.txt).
 *
 * Controller: PI with BACK-CALCULATION ANTI-WINDUP.
 *         u = Kp*e + integ;  clamp u to [0, VBUS];
 *         integ += Ki*TS*e + (TS/TT)*(u_sat - u_unsat)
 *         With TT = Kp/Ki, whenever the command saturates (it does, for
 *         ~0.3 s on every large step -- see closedloop_step.png) the
 *         second term bleeds the integrator so it never winds past the
 *         rail. Without it the 0->300 rad/s step overshoots 31% instead
 *         of 6% (simulated in control-design/pi_design.py, same
 *         difference equations as below).
 *
 * Serial (115200):
 *   s<float>  setpoint in rad/s, enters RUN mode      e.g.  s300
 *   i         run the system-ID staircase, stream CSV (same sequence as
 *             system-id/generate_synthetic_data.py; pipe to a file and
 *             feed to fit_plant.py --csv)
 *   x         stop (PWM off, integrator cleared)
 *   t         toggle 10 Hz telemetry in RUN mode
 *   ?         help
 *
 * Gains below are OUTPUTS of the design pipeline -- do not hand-tune
 * here. Re-run system-id + control-design on real data instead:
 *   generated by control-design/pi_design.py (design_report.txt)
 */

// ---- design constants (from control-design/results/design_report.txt) ----
#define KP          0.0446f   // V per rad/s
#define KI          0.3493f   // V per rad/s per s
#define TS          0.010f    // s (100 Hz loop)
#define F_MEAS_LPF  15.0f     // Hz measurement filter (in the loop design)
#define VBUS        5.00f     // V, Project 1 buck output

// ---- rig constants ----
#define CPR         48        // encoder counts/rev, x4-decoded
#define PIN_PWM     11        // Timer1 -> 31.37 kHz
#define PIN_ENC_A   2         // INT4
#define PIN_ENC_B   3         // INT5

// ---- sysid staircase (keep identical to generate_synthetic_data.py) ----
const float SYSID_LEVELS[] = {0.0, 1.5, 3.0, 4.5, 2.5, 5.0, 1.0, 3.5, 0.0};
const uint8_t SYSID_N = sizeof(SYSID_LEVELS) / sizeof(SYSID_LEVELS[0]);
#define SYSID_HOLD_S 2.5f

// ---- stall guard ("traction fault"): full command, no motion ----
#define STALL_V_FRAC   0.9f   // command above this fraction of VBUS...
#define STALL_W_MIN    20.0f  // ...while speed below this [rad/s]...
#define STALL_TIME_S   1.5f   // ...for this long -> latch off

// ---- derived ----
const float TT       = KP / KI;                    // anti-windup [s]
const float ALPHA    = 1.0f - expf(-2.0f * PI * F_MEAS_LPF * TS);
const float RADS_PER_COUNT = 2.0f * PI / CPR;
const uint32_t TS_US = (uint32_t)(TS * 1e6f);

// ---- encoder ISR state ----
volatile long enc_count = 0;
volatile uint8_t enc_prev = 0;
// quadrature transition table: index = (prev<<2)|curr, value = -1/0/+1
const int8_t QTAB[16] = {0,+1,-1,0, -1,0,0,+1, +1,0,0,-1, 0,-1,+1,0};

void encIsr() {
  uint8_t a = (PINE >> 4) & 1;     // pin 2 = PE4
  uint8_t b = (PINE >> 5) & 1;     // pin 3 = PE5
  uint8_t curr = (a << 1) | b;
  enc_count += QTAB[(enc_prev << 2) | curr];
  enc_prev = curr;
}

// ---- controller state ----
enum Mode { IDLE, RUN, SYSID, FAULT };
Mode mode = IDLE;
float w_ref = 0.0f;         // setpoint [rad/s]
float w_filt = 0.0f;        // filtered speed [rad/s]
float integ = 0.0f;         // integrator [V]
long  count_prev = 0;
uint32_t t_next = 0, t_loop0 = 0;
uint16_t k_sysid = 0;       // sample index inside sysid run
float stall_timer = 0.0f;
bool telemetry = false;
uint8_t telediv = 0;

void applyVolts(float v) {
  if (v < 0.0f) v = 0.0f;
  if (v > VBUS) v = VBUS;
  analogWrite(PIN_PWM, (uint8_t)(v / VBUS * 255.0f + 0.5f));
}

void motorOff() { analogWrite(PIN_PWM, 0); integ = 0.0f; }

float readSpeedRaw() {
  noInterrupts();
  long c = enc_count;
  interrupts();
  long d = c - count_prev;
  count_prev = c;
  return d * RADS_PER_COUNT / TS;
}

void setup() {
  Serial.begin(115200);
  pinMode(PIN_PWM, OUTPUT);
  // Timer1 (pins 11,12 on Mega) prescaler 1: 16 MHz/510 = 31.37 kHz
  // phase-correct PWM. Timer0 (millis) untouched.
  TCCR1B = (TCCR1B & 0b11111000) | 0x01;
  motorOff();

  pinMode(PIN_ENC_A, INPUT_PULLUP);
  pinMode(PIN_ENC_B, INPUT_PULLUP);
  enc_prev = ((digitalRead(PIN_ENC_A) << 1) | digitalRead(PIN_ENC_B));
  attachInterrupt(digitalPinToInterrupt(PIN_ENC_A), encIsr, CHANGE);
  attachInterrupt(digitalPinToInterrupt(PIN_ENC_B), encIsr, CHANGE);

  Serial.println(F("# motor_speed_pi -- s<rad/s> run | i sysid | x stop"
                   " | t telemetry | ? help"));
  t_next = micros() + TS_US;
}

void handleSerial() {
  if (!Serial.available()) return;
  char c = Serial.read();
  switch (c) {
    case 's': {
      float r = Serial.parseFloat();
      if (mode == FAULT) Serial.println(F("# clear fault with x first"));
      else { w_ref = r; mode = RUN; Serial.print(F("# RUN, setpoint "));
             Serial.println(w_ref); }
      break; }
    case 'i':
      if (mode == FAULT) { Serial.println(F("# clear fault with x first")); break; }
      mode = SYSID; k_sysid = 0; motorOff();
      // header consumed by fit_plant.py -- rig facts travel with the data
      Serial.print(F("# vbus_V=")); Serial.print(VBUS, 2);
      Serial.print(F(",ts_s="));    Serial.print(TS, 4);
      Serial.print(F(",cpr="));     Serial.print(CPR);
      Serial.println(F(",source=bench"));
      Serial.println(F("t_s,v_cmd_V,omega_meas_rad_s"));
      break;
    case 'x':
      mode = IDLE; motorOff(); stall_timer = 0.0f;
      Serial.println(F("# IDLE"));
      break;
    case 't': telemetry = !telemetry; break;
    case '?':
      Serial.println(F("# s<rad/s> run | i sysid | x stop | t telemetry"));
      Serial.print(F("# Kp=")); Serial.print(KP, 4);
      Serial.print(F(" Ki=")); Serial.print(KI, 4);
      Serial.print(F(" Ts=")); Serial.print(TS, 3);
      Serial.print(F(" lpf=")); Serial.print(F_MEAS_LPF, 1);
      Serial.print(F("Hz Vbus=")); Serial.println(VBUS, 2);
      break;
    default: break;   // ignore whitespace/newlines
  }
}

void loop() {
  handleSerial();

  // fixed-rate 100 Hz scheduler (drift-free: increment the deadline)
  if ((int32_t)(micros() - t_next) < 0) return;
  t_next += TS_US;

  float w_raw = readSpeedRaw();
  w_filt += ALPHA * (w_raw - w_filt);

  switch (mode) {

    case RUN: {
      // PI with back-calculation anti-windup -- keep identical to
      // control-design/pi_design.py simulate_firmware()
      float e = w_ref - w_filt;
      float u_unsat = KP * e + integ;
      float u = constrain(u_unsat, 0.0f, VBUS);
      integ += KI * TS * e + (TS / TT) * (u - u_unsat);
      applyVolts(u);

      // stall guard: commanded hard but shaft not moving -> latch off
      // (locked rotor at 5 V pulls 1.85 A continuously; legal for the
      // buck but pointless and hot -- treat as a traction fault)
      if (u > STALL_V_FRAC * VBUS && w_filt < STALL_W_MIN)
        stall_timer += TS;
      else
        stall_timer = 0.0f;
      if (stall_timer > STALL_TIME_S) {
        mode = FAULT; motorOff();
        Serial.println(F("# FAULT: stall detected, PWM off ('x' to clear)"));
      }

      if (telemetry && ++telediv >= 10) {   // 10 Hz status
        telediv = 0;
        Serial.print(w_ref); Serial.print('\t');
        Serial.print(w_filt); Serial.print('\t');
        Serial.println(u, 3);
      }
      break; }

    case SYSID: {
      // open-loop staircase, stream RAW (unfiltered) speed: the fit
      // wants the noise, and filtering would bias the dynamics
      uint16_t per = (uint16_t)(SYSID_HOLD_S / TS);
      uint16_t lev = k_sysid / per;
      if (lev >= SYSID_N) {
        motorOff(); mode = IDLE;
        Serial.println(F("# sysid done -> IDLE"));
        break;
      }
      float v = SYSID_LEVELS[lev];
      applyVolts(v);
      Serial.print(k_sysid * TS, 3); Serial.print(',');
      Serial.print(v, 3);            Serial.print(',');
      Serial.println(w_raw, 4);
      k_sysid++;
      break; }

    case FAULT:
    case IDLE:
    default:
      motorOff();
      break;
  }
}
